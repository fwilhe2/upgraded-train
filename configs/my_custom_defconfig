## configs/my_custom_defconfig
```kconfig
BR2_x86_64=y
BR2_PACKAGE_HOST_LINUX_HEADERS_CUSTOM_6_12=y
BR2_DOWNLOAD_FORCE_CHECK_HASHES=y
BR2_SYSTEM_DHCP="eth0"
BR2_ROOTFS_POST_BUILD_SCRIPT="board/custom/post-build.sh"
BR2_ROOTFS_POST_IMAGE_SCRIPT="board/custom/post-image.sh"
BR2_ROOTFS_POST_SCRIPT_ARGS="$(BR2_DEFCONFIG)"
BR2_LINUX_KERNEL=y
BR2_LINUX_KERNEL_CUSTOM_VERSION=y
BR2_LINUX_KERNEL_CUSTOM_VERSION_VALUE="6.12.47"
BR2_LINUX_KERNEL_USE_CUSTOM_CONFIG=y
BR2_LINUX_KERNEL_NEEDS_HOST_LIBELF=y
BR2_TARGET_ROOTFS_EXT2=y
BR2_TARGET_ROOTFS_EXT2_SIZE="500M"

# BR2_TARGET_ROOTFS_TAR is not set
BR2_PACKAGE_HOST_QEMU=y
BR2_PACKAGE_HOST_QEMU_SYSTEM_MODE=y



BR2_TOOLCHAIN_BUILDROOT=y
BR2_TOOLCHAIN_BUILDROOT_CXX=y
BR2_TOOLCHAIN_EXTERNAL=n
BR2_TOOLCHAIN_HAS_THREADS=y

BR2_TOOLCHAIN_BUILDROOT_GLIBC=y
BR2_LIBC_GLIBC=y


# Kernel
BR2_LINUX_KERNEL_DEFCONFIG="x86_64_defconfig"

# Point Buildroot to our kernel fragment(s); fragments will be merged with the base defconfig
BR2_LINUX_KERNEL_CUSTOM_CONFIG_FRAGMENT_FILES="board/custom/linux/kernel-fragment.cfg"

# Init system
BR2_PACKAGE_SYSTEMD=y
BR2_INIT_SYSTEMD=y

# Basic system
BR2_PACKAGE_BUSYBOX=y
BR2_PACKAGE_E2FSPROGS=y
BR2_PACKAGE_SHADOW=y
BR2_PACKAGE_EUDEV=y

# Networking & utilities
BR2_PACKAGE_IPROUTE2=y
BR2_PACKAGE_NFTABLES=y
BR2_PACKAGE_BRIDGE_UTILS=y
BR2_PACKAGE_CA_CERTIFICATES=y
BR2_PACKAGE_WGET=y

# Container runtimes and helpers (2025.11: package symbols expected to be available)
BR2_PACKAGE_PODMAN=y
BR2_PACKAGE_CONTAINERD=y
BR2_PACKAGE_RUNC=y
BR2_PACKAGE_CRUN=y
BR2_PACKAGE_UIDMAP=y
BR2_PACKAGE_SLIRP4NETNS=y
BR2_PACKAGE_CNI_PLUGINS=y

# Additional useful packages for container images and overlays
BR2_PACKAGE_OVERLAYFS=y
BR2_PACKAGE_XZ_UTILS=y

# Optional / useful extras
BR2_PACKAGE_SYSTEMD_JOURNALD=y
BR2_PACKAGE_STRACE=n
BR2_PACKAGE_GDB=n

# Filesystem images
BR2_GENIMAGE=y

# Enable SSH for convenience (can disable for smaller image)
BR2_PACKAGE_OPENSSH_SERVER=n
BR2_ENABLE_SSH=y

# Locale/time
BR2_PACKAGE_SYSTEMD_TIMEDATED=y

# QEMU related (guest utilities) - not required for target container runtime but handy
BR2_PACKAGE_QEMU_GUEST_AGENT=n

# End of defconfig
```
